## target/linux/ramips/files/drivers/net/ethernet/mediateksdk/Kconfig
```kconfig
# SPDX-License-Identifier: GPL-2.0-only
config NET_VENDOR_MEDIATEK_SDK
	bool "MediaTek sdk ethernet driver"
	depends on ARCH_MEDIATEK || SOC_MT7621 || SOC_MT7620
	help
	  If you have a Mediatek SoC with ethernet, say Y.

if NET_VENDOR_MEDIATEK_SDK

config NET_MEDIATEK_SOC_SDK
	tristate "MediaTek SoC Gigabit Ethernet support"
	select PHYLINK
	help
	  This driver supports the gigabit ethernet MACs in the
	  MediaTek SoC family.

config MEDIATEK_NETSYS_V2
	tristate "MediaTek Ethernet NETSYS V2 support"
	depends on ARCH_MEDIATEK && NET_MEDIATEK_SOC_SDK
	help
	  This options enable MTK Ethernet NETSYS V2 support

config MEDIATEK_NETSYS_V3
	tristate "MediaTek Ethernet NETSYS V3 support"
	depends on ARCH_MEDIATEK && NET_MEDIATEK_SOC_SDK
	help
	  This options enable MTK Ethernet NETSYS V3 support for
	  XGMAC and USXGMII.

config NET_MEDIATEK_HNAT
	tristate "MediaTek HW NAT support"
	depends on NET_MEDIATEK_SOC_SDK
	select NETFILTER
	select NETFILTER_ADVANCED
	select NETFILTER_FAMILY_BRIDGE
	select NETFILTER_INGRESS
	select NETFILTER_XTABLES
	select BRIDGE_NETFILTER
	select IP_NF_IPTABLES
        select CONNTRACK
	help
	  This driver supports the hardward Network Address Translation
	  in the MediaTek MT7986/MT2701/MT7622/MT7629/MT7621 chipset
	  family.

endif #NET_VENDOR_MEDIATEK_SDK
```
